VERSION ""

NS_ :

BS_:

BU_:

BO_ 256 Botschaft: 8 Vector__XXX
 SG_ Signal : 0|16@1- (1,0) [4|100] "" Vector__XXX
